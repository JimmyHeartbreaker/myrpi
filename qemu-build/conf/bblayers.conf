## qemu-build/conf/bblayers.conf
```bitbake
LCONF_VERSION = "7"

BBPATH = "${TOPDIR}"

BSPDIR := "${@os.path.abspath(os.path.dirname(d.getVar('FILE',True)) + '/../..')}"

BBFILES ?= ""
BBLAYERS ?= " \
  ${BSPDIR}/sources/poky/meta \
  ${BSPDIR}/sources/meta-virtualization \
  ${BSPDIR}/sources/meta-rust \
  ${BSPDIR}/sources/poky/meta-poky \
  ${BSPDIR}/sources/poky/meta-yocto-bsp \
  ${BSPDIR}/sources/meta-openembedded/meta-oe \
  ${BSPDIR}/sources/meta-openembedded/meta-filesystems \
  ${BSPDIR}/sources/meta-openembedded/meta-multimedia \
  ${BSPDIR}/sources/meta-openembedded/meta-networking \
  ${BSPDIR}/sources/meta-openembedded/meta-python \
  ${BSPDIR}/sources/meta-qt5 \
  ${BSPDIR}/sources/meta-raspberrypi \
  ${BSPDIR}/sources/meta-security/meta-tpm \
  ${BSPDIR}/sources/meta-openembedded/meta-perl \
  ${BSPDIR}/sources/meta-mypi \
  ${BSPDIR}/sources/meta-iotedge \
  ${BSPDIR}/sources/meta-clang \
  "
```

## qemu-build/conf/local.conf
```bitbake
MACHINE ?= "qemuarm64"
DISTRO_FEATURES:append = " wifi virtualization wayland directfb opengl systemd pam bluetooth"
DISTRO_FEATURES:remove = "x11"
IMAGE_INSTALL:append = "bash docker ca-certificates connman connman-client weston gtk+3 starfield mydriver sensorhub helloworld kernel-dev iw dropbear dhcpcd bind"
IMAGE_FEATURES:append = " tools-debug debug-tweaks ssh-server-dropbear tools-sdk"
INIT_MANAGER = "systemd"
ENABLE_I2C = "1"
ENABLE_UART = "1"
RPI_EXTRA_CONFIG = ' \n \
    dtoverlay=miniuart-bt \n \
    '

PACKAGECONFIG:append:pn-qemu-system-native = " gtk+"
```

## rpi-build/conf/local.conf
```bitbake
MACHINE ?= "raspberrypi4-64"
DISTRO_FEATURES:append = " wifi virtualization wayland directfb opengl systemd pam"
DISTRO_FEATURES:remove = "x11"
IMAGE_INSTALL:append = "docker ca-certificates connman connman-client weston gtk+3 starfield mydriver sensorhub helloworld kernel-dev iw dropbear dhcpcd bind init-ifupdown" 
#aziot-edged 
IMAGE_FEATURES:append = " tools-debug debug-tweaks ssh-server-dropbear tools-sdk"
INIT_MANAGER = "systemd"
ENABLE_I2C = "1"
ENABLE_UART = "1"
RPI_EXTRA_CONFIG = ' \n \
    dtoverlay=miniuart-bt \n \
    '
LICENSE_FLAGS_ACCEPTED = "synaptics-killswitch"
GPU_MEM = "128"
DISPMANX_OFFLINE = "1"
DISABLE_OVERSCAN = "1"

DL_DIR = "${TOPDIR}/../qemu-build/downloads"
SSTATE_DIR="${TOPDIR}/../qemu-build/sstate-cache"
```
